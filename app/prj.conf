## CMakeLists.txt
```
# SPDX-License-Identifier: Apache-2.0

cmake_minimum_required(VERSION 3.20.0)

find_package(Zephyr REQUIRED HINTS $ENV{ZEPHYR_BASE})
project(test_app)

target_sources(app PRIVATE src/main.c)
```

## west.yml
```
# Copyright (c) 2025 Marcin Bober
# SPDX-License-Identifier: Apache-2.0

manifest:
  self:
    path: app

  remotes:
    - name: mbober
      url-base: https://github.com/mbober1
    - name: upstream
      url-base: https://github.com/zephyrproject-rtos

  projects:
    - name: zephyr
      remote: upstream
      repo-path: zephyr
      revision: v4.4.0
      clone-depth: 1
      import:
        name-allowlist:
          - cmsis
          - cmsis-dsp
          - cmsis_6
          - hal_stm32
          - segger

    # - name: mt6701
    #   path: modules/lib/mt6701
    #   revision: master
    #   url: https://github.com/mbober1/MT6701-Zephyr-Module

    # - name: spinner
    #   path: modules/lib/spinner
    #   revision: main
    #   url: https://github.com/teslabs/spinner
```

## prj.conf
```kconfig
# CONFIG_MT6701=y
CONFIG_GPIO=y
CONFIG_INPUT=y
CONFIG_LED=y
CONFIG_SERIAL=y
CONFIG_PRINTK=y

# CONFIG_SENSOR_ASYNC_API=y
# CONFIG_SPI_RTIO=y

# compiler
CONFIG_DEBUG_OPTIMIZATIONS=y
# CONFIG_NO_OPTIMIZATIONS=y

# console
CONFIG_CONSOLE=y

# UART console
CONFIG_UART_CONSOLE=y

# logging
CONFIG_LOG=y
CONFIG_SHELL=y
# CONFIG_MT6701_ENABLE_CRC=y


# CONFIG_USBC_STACK=y
# CONFIG_USBC_CSM_SINK_ONLY=y
# CONFIG_USBC_THREAD_PRIORITY=10
# CONFIG_ADC=y
# CONFIG_BUILD_OUTPUT_VIF=y

# CONFIG_UART_CONSOLE=n
# CONFIG_RTT_CONSOLE=y
# CONFIG_USE_SEGGER_RTT=y
```

## src/main.c
```c
#include <stdio.h>
#include <zephyr/kernel.h>
#include <zephyr/input/input.h>

K_MSGQ_DEFINE(button_action_msgq, sizeof(int), 16, 4);

void button_action_work_handler(struct k_work *work) {
	while (k_msgq_num_used_get(&button_action_msgq)) {
	uint32_t button_states;
		k_msgq_get(&button_action_msgq, &button_states, K_NO_WAIT);
		printf("Button states: %d\n", button_states);
		k_yield();
	}
}

K_WORK_DEFINE(button_action_work, button_action_work_handler);

static void button_input_cb(struct input_event *evt, void *user_data)
{
	k_msgq_put(&button_action_msgq, &(evt->value), K_NO_WAIT);
	k_work_submit(&button_action_work);
}

INPUT_CALLBACK_DEFINE(NULL, button_input_cb, NULL);

int main(void)
{
	while (1) {
		k_sleep(K_FOREVER);
	}
	return 0;
}

FUNC_NORETURN __weak void arch_system_halt(unsigned int reason)
{
	ARG_UNUSED(reason);

	(void)arch_irq_lock();
	for (;;) {
		__asm("bkpt #0");
	}
}
```
